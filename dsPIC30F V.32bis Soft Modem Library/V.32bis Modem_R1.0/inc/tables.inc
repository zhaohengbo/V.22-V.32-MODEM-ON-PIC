;******************************************************************************
;File Name:    TABLES.H
;******************************************************************************

;------------------------------------------------------------------------------
;Global definitions for initialized data
;------------------------------------------------------------------------------

.global IpBpCoefs

.global V32PsfCoefs
.global V32EncTab
.global V32RateSymbols
.global V32NT9600SymbolsI
.global V32NT9600SymbolsQ
.global V32QuadBits
.global V32TrnSymbolsI
.global V32TrnSymbolsQ
.global V32SineTab
.global ECSineTab  

.global HilbCoefs   

.global AAFilter
.global ACFilter

.global SiplDiffCoefs
.global SiplMainCoefs

.global V22Symb1200
.global V22Symb2400
.global V22DiffEncTab
.global V22PsfCoefs
.global V22QuadBits
.global V22OrgBpCoefs
.global V22AnsBpCoefs

.global V23Bp75
.global V23WbBp1500Coefs
.global V23WbBp1700Coefs
.global V23Lpf1200
.global V23Lpf600
.global V23Lpf75

.global V21LpCoefs
.global V21WbBp1750Coefs
.global V21WbBp1080Coefs

.global B103WbBp2125Coefs
.global B103WbBp1170Coefs

.global V25AnswerBandCoefs
.global V25AnsAmFilter

.global OrgDetectV32Coefs
.global OrgDetectV22Coefs

.global ClprgBandCoefs
.global cpDTBandCoefs
.global cpBTBandCoefs
.global cpRBTBandCoefs

.global TrelDiffEncTab
.global TrelCoords_7200
.global TrelCoords_9600
.global TrelCoords_12000
.global TrelCoords_14400

.global PastStatesTab
.global DiffDecTab
.global BitPattern_7200
.global BitPattern_9600
.global BitPattern_12000
.global BitPattern_14400

;******************************************************************************
;    END OF FILE
;******************************************************************************
